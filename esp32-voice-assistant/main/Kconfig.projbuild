## esp32-voice-assistant/main/Kconfig.projbuild
```kconfig
menu "Example Connection Configuration"

    config EXAMPLE_WIFI_SSID
        string "WiFi SSID"
        default "myssid"
        help
            SSID (network name) for the example to connect to.

    config EXAMPLE_WIFI_PASSWORD
        string "WiFi Password"
        default "mypassword"
        help
            WiFi password (WPA or WPA2) for the example to use.

    config EXAMPLE_WIFI_SCAN_METHOD
        int
        default 1

    config EXAMPLE_WIFI_CONNECT_AP_BY_SIGNAL
        bool
        default y

    config EXAMPLE_WIFI_SCAN_RSSI_THRESHOLD
        int
        default -127

endmenu
```

## esp32-voice-assistant/sdkconfig.defaults
```kconfig
# Configuración del proyecto

# Selección de board (BSP interno usa este flag)
CONFIG_BSP_BOARD_ESP32_S3_BOX_3=y

# LVGL
CONFIG_LV_COLOR_DEPTH_16=y
CONFIG_LV_COLOR_16_SWAP=n

# ESP System
CONFIG_ESP_MAIN_TASK_STACK_SIZE=8192
CONFIG_ESP_TASK_WDT_TIMEOUT_S=10

# FreeRTOS
CONFIG_FREERTOS_HZ=1000

# Memoria / PSRAM
CONFIG_SPIRAM=y
CONFIG_SPIRAM_MODE_OCT=y
CONFIG_SPIRAM_TYPE_AUTO=y
CONFIG_SPIRAM_SPEED_80M=y
CONFIG_SPIRAM_BOOT_INIT=y
CONFIG_SPIRAM_USE_MALLOC=y
CONFIG_SPIRAM_MALLOC_ALWAYSINTERNAL=16384
CONFIG_SPIRAM_MALLOC_RESERVE_INTERNAL=32768
```
